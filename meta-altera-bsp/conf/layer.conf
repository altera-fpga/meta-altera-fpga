## meta-altera-bsp/conf/machine/agilex27.conf
```bitbake
#@TYPE: Machine
#@NAME: Altera SoCFPGA AGILEX27
#@DESCRIPTION: Machine configuration for the AGILEX27 SoCFPGA

require conf/machine/include/socfpga_armv8-2a.inc

# Use custom ubifs settings from meta-custom if available, otherwise use default
require ${@bb.utils.contains('BBFILE_COLLECTIONS', 'meta-custom', 'conf/machine/include/ubifs.inc', 'conf/machine/include/ubifs_agilex27.inc', d)}

# default root home directory
ROOT_HOME = "/home/root"
# Machine name with strips trailing letter
MACHINE_STRIP = "agilex27"

# U-Boot configuration - use defconfig from kas.yml
UBOOT_CONFIG = "agilex27-socdk-atf"
UBOOT_CONFIG[agilex27-socdk-atf] = "${UBOOT_DEFCONFIG}"

# Define multilib target
require conf/multilib.conf
MULTILIBS = "multilib:lib32"
DEFAULTTUNE:virtclass-multilib-lib32 = "armv7athf-neon"

# Specify the 32-bit libraries to be added to all images
IMAGE_INSTALL:append = " lib32-zlib"

KBUILD_DEFCONFIG ?= "defconfig"

UBOOT_BINARY = "u-boot.itb"
UBOOT_SUFFIX = "itb"

KERNEL_IMAGETYPE = "Image"

LINUX_DTB_FILE ?= "socfpga_agilex27_socdk.dtb"

KERNEL_DEVICETREE ?= "\
			altera/${LINUX_DTB_FILE} \
			"
UBOOT_ENTRYPOINT = "0x4000000"
UBOOT_LOADADDRESS = "0x4000000"
FIT_KERNEL_COMP_ALG = "none"

SERIAL_CONSOLES ?= "115200;ttyS0"

EXTRA_IMAGECMD:jffs2 ?= "-n -q -e 0x10000"

UBOOT_EXTLINUX ?= "1"
UBOOT_EXTLINUX_LABELS ?= "default"
UBOOT_EXTLINUX_DEFAULT_LABEL ?= "AGILEX27 SOCDK SDMMC"

UBOOT_EXTLINUX_MENU_DESCRIPTION:default ?= "AGILEX27 SOCDK SDMMC"
UBOOT_EXTLINUX_KERNEL_IMAGE:default ?= "../${KERNEL_IMAGETYPE}"
UBOOT_EXTLINUX_FDTDIR:default ?= ".."
UBOOT_EXTLINUX_CONSOLE ?= "console=ttyS0,115200n8"
UBOOT_EXTLINUX_KERNEL_ARGS:default ?= "rootwait rw earlyprintk"
UBOOT_EXTLINUX_ROOT:default ?= "root=/dev/mmcblk0p2"

UBOOT_DEVICE_TREE ?= "socfpga_agilex27_socdk.dtb"

MACHINE_ESSENTIAL_EXTRA_RRECOMMENDS:append = "device-tree fpga-bitstream"

EXTRA_IMAGEDEPENDS:append = " \
		u-boot-socfpga-scr \
		u-boot-socfpga-env-var \
		"

IMAGE_BOOT_FILES ?= " \
			${UBOOT_BINARY} \
			Image \
			"

IMAGE_TYPE ?= "gsrd"
DISTRO_FEATURES:append = " systemd usrmerge"
INIT_MANAGER = "systemd"

WKS_FILE ?= "sdimage.wks"
IMAGE_FSTYPES:append = " wic jffs2 tar.gz multiubi cpio cpio.gz cpio.gz.u-boot"
IMAGE_FEATURES:append = " allow-empty-password empty-root-password"
```

## meta-altera-bsp/conf/machine/agilex5e.conf
```bitbake
#@TYPE: Machine
#@NAME: Altera SoCFPGA Agilex5
#@DESCRIPTION: Machine configuration for the Agilex5 SoCFPGA

require conf/machine/include/socfpga_armv8-2a.inc

# Use custom ubifs settings from meta-custom if available, otherwise use default
require ${@bb.utils.contains('BBFILE_COLLECTIONS', 'meta-custom', 'conf/machine/include/ubifs.inc', 'conf/machine/include/ubifs_agilex5.inc', d)}

# Machine name with strips trailing letter
MACHINE_STRIP = "agilex5"

# U-Boot configuration - use defconfig from kas.yml
UBOOT_CONFIG = "agilex5e-socdk-atf"
UBOOT_CONFIG[agilex5e-socdk-atf] = "${UBOOT_DEFCONFIG}"

# Define multilib target
require conf/multilib.conf
MULTILIBS = "multilib:lib32"
DEFAULTTUNE:virtclass-multilib-lib32 = "armv7athf-neon"

# Specify the 32-bit libraries to be added to all images
IMAGE_INSTALL:append = " lib32-zlib"

KBUILD_DEFCONFIG ?= "defconfig"

UBOOT_BINARY = "u-boot.itb"
UBOOT_SUFFIX = "itb"

KERNEL_CLASSES:append = " kernel-fitimage"
KERNEL_IMAGETYPE = "Image"

LINUX_DTB_FILE ?= "socfpga_agilex5_socdk.dtb"

KERNEL_DEVICETREE ?= "\
			intel/${LINUX_DTB_FILE} \
			"
UBOOT_ENTRYPOINT = "0x4000000"
UBOOT_LOADADDRESS = "0x4000000"
FIT_KERNEL_COMP_ALG = "none"

SERIAL_CONSOLES ?= "115200;ttyS0"

EXTRA_IMAGECMD:jffs2 ?= "-n -q -e 0x10000"

UBOOT_EXTLINUX ?= "1"
UBOOT_EXTLINUX_LABELS ?= "default"
UBOOT_EXTLINUX_DEFAULT_LABEL ?= "Agilex5 SOCDK SDMMC"

UBOOT_EXTLINUX_MENU_DESCRIPTION:default ?= "Agilex5 SOCDK SDMMC"
UBOOT_EXTLINUX_KERNEL_IMAGE:default ?= "../${KERNEL_IMAGETYPE}"
UBOOT_EXTLINUX_FDTDIR:default ?= ".."
UBOOT_EXTLINUX_CONSOLE ?= "console=ttyS0,115200n8"
UBOOT_EXTLINUX_KERNEL_ARGS:default ?= "rootwait rw earlyprintk"
UBOOT_EXTLINUX_ROOT:default ?= "root=/dev/mmcblk0p2"

UBOOT_DEVICE_TREE ?= "socfpga_agilex5_socdk.dtb"

MACHINE_ESSENTIAL_EXTRA_RRECOMMENDS:append = "device-tree fpga-bitstream"

EXTRA_IMAGEDEPENDS:append = " \
		u-boot-socfpga-scr \
		u-boot-socfpga-env-var \
		"

IMAGE_BOOT_FILES ?= " \
			${UBOOT_BINARY} \
			Image \
			"

IMAGE_TYPE ?= "gsrd"
DISTRO_FEATURES:append = " systemd usrmerge"
VIRTUAL-RUNTIME_init_manager = "systemd"

WKS_FILE ?= "sdimage.wks"
IMAGE_FSTYPES:append = " wic jffs2 tar.gz multiubi cpio cpio.gz cpio.gz.u-boot"
IMAGE_FEATURES:append = " allow-empty-password empty-root-password"
```

## meta-altera-bsp/conf/machine/agilex7m.conf
```bitbake
#@TYPE: Machine
#@NAME: Altera SoCFPGA Agilex7M
#@DESCRIPTION: Machine configuration for the Agilex7M SoCFPGA

require conf/machine/include/socfpga_armv8a.inc
require ${@bb.utils.contains('BBFILE_COLLECTIONS', 'meta-custom', 'conf/machine/include/ubifs.inc', 'conf/machine/include/ubifs_agilex.inc', d)}

# default root home directory
ROOT_HOME = "/home/root"

MACHINE_STRIP = "agilex7"

# ATF platform directory (still "agilex" in arm-trusted-firmware)
ATFPLAT ?= "agilex"

# U-Boot configuration - use defconfig from kas.yml
UBOOT_CONFIG = "agilex-socdk-atf"
UBOOT_CONFIG[agilex-socdk-atf] = "${UBOOT_DEFCONFIG}"

KBUILD_DEFCONFIG ?= "defconfig"

UBOOT_BINARY = "u-boot.itb"
UBOOT_SUFFIX = "itb"

KERNEL_IMAGETYPE = "Image"

LINUX_DTB_FILE ?= "socfpga_agilex7m_socdk.dtb"

KERNEL_DEVICETREE ?= "\
			intel/${LINUX_DTB_FILE} \
			"
UBOOT_ENTRYPOINT = "0x4000000"
UBOOT_LOADADDRESS = "0x4000000"
FIT_KERNEL_COMP_ALG = "none"

SERIAL_CONSOLES ?= "115200;ttyS0"

EXTRA_IMAGECMD:jffs2 ?= "-n -q -e 0x10000"

UBOOT_EXTLINUX ?= "1"
UBOOT_EXTLINUX_LABELS ?= "default"
UBOOT_EXTLINUX_DEFAULT_LABEL ?= "Agilex SOCDK SDMMC"

UBOOT_EXTLINUX_MENU_DESCRIPTION:default ?= "Agilex SOCDK SDMMC"
UBOOT_EXTLINUX_KERNEL_IMAGE:default ?= "../${KERNEL_IMAGETYPE}"
UBOOT_EXTLINUX_FDTDIR:default ?= ".."
UBOOT_EXTLINUX_CONSOLE ?= "console=ttyS0,115200n8"
UBOOT_EXTLINUX_KERNEL_ARGS:default ?= "rootwait rw earlyprintk"
UBOOT_EXTLINUX_ROOT:default ?= "root=/dev/mmcblk0p2"

UBOOT_DEVICE_TREE ?= "socfpga_agilex_socdk.dtb"

MACHINE_ESSENTIAL_EXTRA_RRECOMMENDS:append = "device-tree fpga-bitstream"

EXTRA_IMAGEDEPENDS:append = " \
		u-boot-socfpga-scr \
		u-boot-socfpga-env-var \
		"

IMAGE_BOOT_FILES ?= " \
			${UBOOT_BINARY} \
			boot.scr.uimg \
			kernel.itb \
			Image \
			"

IMAGE_TYPE ?= "gsrd"
DISTRO_FEATURES:append = " systemd usrmerge"
INIT_MANAGER = "systemd"

WKS_FILE ?= "sdimage.wks"
IMAGE_FSTYPES:append = " wic tar.gz cpio cpio.gz cpio.gz.u-boot jffs2 multiubi"
IMAGE_FEATURES:append = " allow-empty-password empty-root-password"
```

## meta-altera-bsp/conf/machine/machine.conf
```bitbake
#@TYPE: Machine
#@NAME: Altera SoCFPGA Agilex5
#@DESCRIPTION: Machine configuration for the Agilex5 SoCFPGA

require conf/machine/include/socfpga_armv8-2a.inc
require conf/machine/include/ubifs_agilex5.inc

# Define multilib target
require conf/multilib.conf
MULTILIBS = "multilib:lib32"
DEFAULTTUNE:virtclass-multilib-lib32 = "armv7athf-neon"

# Specify the 32-bit libraries to be added to all images
IMAGE_INSTALL:append = " lib32-zlib"

KBUILD_DEFCONFIG ?= "defconfig"

UBOOT_BINARY = "u-boot.itb"
UBOOT_SUFFIX = "itb"

KERNEL_CLASSES:append = " kernel-fitimage"
KERNEL_IMAGETYPE = "Image"

KERNEL_DEVICETREE ?= "\
			intel/socfpga_agilex5_socdk.dtb \
			"
UBOOT_ENTRYPOINT = "0x4000000"
UBOOT_LOADADDRESS = "0x4000000"
FIT_KERNEL_COMP_ALG = "none"

SERIAL_CONSOLES ?= "115200;ttyS0"

EXTRA_IMAGECMD:jffs2 ?= "-n -q -e 0x10000"

UBOOT_EXTLINUX ?= "1"
UBOOT_EXTLINUX_LABELS ?= "default"
UBOOT_EXTLINUX_DEFAULT_LABEL ?= "Agilex5 SOCDK SDMMC"

UBOOT_EXTLINUX_MENU_DESCRIPTION:default ?= "Agilex5 SOCDK SDMMC"
UBOOT_EXTLINUX_KERNEL_IMAGE:default ?= "../${KERNEL_IMAGETYPE}"
UBOOT_EXTLINUX_FDTDIR:default ?= ".."
UBOOT_EXTLINUX_CONSOLE ?= "console=ttyS0,115200n8"
UBOOT_EXTLINUX_KERNEL_ARGS:default ?= "rootwait rw earlyprintk"
UBOOT_EXTLINUX_ROOT:default ?= "root=/dev/mmcblk0p2"

UBOOT_DEFAULT_DEVICE_TREE = "socfpga_agilex5_socdk.dtb"
UBOOT_DEVICE_TREE ?= "${UBOOT_DEFAULT_DEVICE_TREE}"

MACHINE_ESSENTIAL_EXTRA_RRECOMMENDS:append = "device-tree fpga-bitstream"

EXTRA_IMAGEDEPENDS:append = " \
		u-boot-socfpga-scr \
		u-boot-socfpga-env-var \
		"

# Add variables for wic creation of sdcard image
IMAGE_BOOT_FILES ?= " \
			${UBOOT_BINARY} \
			Image \
			socfpga_agilex5_socdk.dtb \
			"

IMAGE_TYPE ?= "gsrd"
DISTRO_FEATURES:append = " systemd usrmerge"
VIRTUAL-RUNTIME_init_manager = "systemd"

ROOT_HOME = "/root"

WKS_FILE ?= "sdimage.wks"
IMAGE_FSTYPES:append = " wic jffs2 tar.gz multiubi cpio cpio.gz cpio.gz.u-boot"
IMAGE_FEATURES:append = " allow-empty-password empty-root-password"
```

## meta-altera-platform/conf/layer.conf
```bitbake
# We have a conf and classes directory, append to BBPATH
BBPATH .= ":${LAYERDIR}"

# Security backport version preferences
PREFERRED_VERSION_curl = "8.20.0"
PREFERRED_VERSION_expat = "2.8.1"
PREFERRED_VERSION_libxml2 = "2.15.3"

BBFILE_PATTERN_altera-platform := "^${LAYERDIR}/"

BBFILES:append = " ${LAYERDIR}/recipes-images/*/*.bb"
BBFILES:append = " ${LAYERDIR}/recipes-connectivity/linuxptp/*.bb"
BBFILES:append = " ${LAYERDIR}/recipes-connectivity/open62541/*.bb"
BBFILES:append = " ${LAYERDIR}/recipes-connectivity/tsn-ref-sw/*.bb"
BBFILES:append = " ${LAYERDIR}/recipes-connectivity/xdp-tools/*.bb"
BBFILES:append = " ${LAYERDIR}/recipes-connectivity/curl/*.bb"
BBFILES:append = " ${LAYERDIR}/recipes-core/*/*.bbappend"
BBFILES:append = " ${LAYERDIR}/recipes-core/expat/*.bb"
BBFILES:append = " ${LAYERDIR}/recipes-core/libxml/*.bb"
BBFILES:append = " ${LAYERDIR}/recipes-devtools/*/*.bbappend"
BBFILES:append = " ${LAYERDIR}/recipes-benchmarking/*/*.bb"
BBFILES:append = " ${LAYERDIR}/recipes-gsrd/gsrd-apps/*.bb"
BBFILES:append = " ${LAYERDIR}/recipes-gsrd/gsrd-initscripts/*.bb"
BBFILES:append = " ${LAYERDIR}/recipes-gsrd/gsrd-intel-fcs-lib/*.bb"
BBFILES:append = " ${LAYERDIR}/recipes-gsrd/gsrd-lighttpd-conf/*.bb"
BBFILES:append = " ${LAYERDIR}/recipes-gsrd/gsrd-pio-interrupt/*.bb"
BBFILES:append = " ${LAYERDIR}/recipes-gsrd/gsrd-unilibrsu-lib/*.bb"
BBFILES:append = " ${LAYERDIR}/recipes-gsrd/remote-debug-app/*.bb"
BBFILES:append = " ${LAYERDIR}/recipes-gsrd/gsrd-webcontent/*.bb"
BBFILES:append = " ${LAYERDIR}/recipes-gsrd/libarchive/libarchive_%.bbappend"

# XEN Hypervisor Build Support
# Conditionally include XEN recipes when HYP_BUILD is set to 1
HYP_BUILD ??= "0"
BBFILES:append = "${@bb.utils.contains('HYP_BUILD', '1', ' ${LAYERDIR}/recipes-gsrd/socfpga-xen-passthrough/*.bb', '', d)}"
BBFILES:append = "${@bb.utils.contains('HYP_BUILD', '1', ' ${LAYERDIR}/recipes-extended/xen/*.bbappend ${LAYERDIR}/recipes-extended/images/xen-image-minimal.bbappend', '', d)}"

BBFILE_COLLECTIONS += "altera-platform"
LAYERSERIES_COMPAT_altera-platform = "^${LAYERDIR}/"
BBFILE_PRIORITY_altera-platform = "5"

LAYERSERIES_COMPAT_altera-platform = "wrynose"

BBDEBUG = "yes"
```
